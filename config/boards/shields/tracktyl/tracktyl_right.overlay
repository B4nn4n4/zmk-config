// tracktyl_right.overlay

#include "tracktyl.dtsi"
#include <input/processors.dtsi>
#include <dt-bindings/zmk/input_transform.h>
#include <zephyr/dt-bindings/input/input-event-codes.h>

&default_transform { // The matrix transform for this board is 6 columns over because the left half is 6 columns wide according to the matrix.
    col-offset = <5>;
};

&kscan0 {
    col-gpios
        = <&pro_micro 5 GPIO_ACTIVE_HIGH> // col1 in the schematic
        , <&pro_micro 6 GPIO_ACTIVE_HIGH> // col2 in the schematic
        , <&pro_micro 7 GPIO_ACTIVE_HIGH> // col3 in the schematic
        , <&pro_micro 8 GPIO_ACTIVE_HIGH> // col4 in the schematic
        , <&pro_micro 9 GPIO_ACTIVE_HIGH> // col5 in the schematic
        ;
};

trackball_spi: &spi1 {
    status = "okay";
    compatible = "nordic,nrf-spim";
    pinctrl-0 = <&spi1_default>;
    pinctrl-1 = <&spi1_sleep>;
    pinctrl-names = "default", "sleep";
    cs-gpios = <&gpio0 20 GPIO_ACTIVE_LOW>;

    trackball: trackball@0 {
        status = "okay";
        compatible = "pixart,pmw3610";
        reg = <0>;
        spi-max-frequency = <2000000>;
        irq-gpios = <&gpio0 6 (GPIO_ACTIVE_LOW | GPIO_PULL_UP)>;
        cpi = <3200>;
        evt-type = <INPUT_EV_REL>;
        x-input-code = <INPUT_REL_X>;
        y-input-code = <INPUT_REL_Y>;
    };
};