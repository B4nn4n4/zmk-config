## config/boards/shields/tracktyl/Kconfig.defconfig
```kconfig
if Tracktyl_LEFT

config ZMK_KEYBOARD_NAME
    default "Tracktyl"

config ZMK_SPLIT_ROLE_CENTRAL
    default y

endif
 

if Tracktyl_LEFT || Tracktyl_RIGHT

config ZMK_SPLIT
    default y

config ZMK_SLEEP
	default y
endif 
```

## config/boards/shields/tracktyl/Kconfig.shield
```kconfig
config Tracktyl_LEFT
    def_bool $(shields_list_contains,tracktyl_left)

config Tracktyl_RIGHT
    def_bool $(shields_list_contains,tracktyl_right)
```

## config/west.yml
```yaml
manifest:
  remotes:
    - name: zmkfirmware
      url-base: https://github.com/zmkfirmware
    - name: badjeff
      url-base: https://github.com/badjeff
  projects:
    - name: zmk
      remote: zmkfirmware
      revision: main
      import: app/west.yml
    - name: zmk-pmw3610-driver
      remote: pmw3610
      revision: main
  self:
    path: config
```
