/* Shared homerow-mods snippet.
 * Inside keymap do:
 *   / { behaviors { #include "behaviors/homerow.dtsi" } }
 * Provides node bhm: balanced 200ms hold-tap.
 */
    bhm: bhm {
        compatible = "zmk,behavior-hold-tap";
        #binding-cells = <2>;
        tapping-term-ms = <200>;
        quick-tap-ms = <0>;
        flavor = "balanced";
        bindings = <&kp>, <&kp>;
    };
