## Kconfig
```kconfig
menu "ZMK Hatsu Module"

config ZMK_BACKLIGHT_MAP
    bool "LED backlight with LED channel mapping"
    select LED

if ZMK_BACKLIGHT_MAP

config ZMK_BACKLIGHT_BRT_STEP
    int "Brightness step in percent"
    range 1 100
    default 20

config ZMK_BACKLIGHT_BRT_START
    int "Default brightness in percent"
    range 1 100
    default 40

config ZMK_BACKLIGHT_ON_START
    bool "Backlight on at boot"
    default y

config ZMK_BACKLIGHT_AUTO_OFF_IDLE
    bool "Turn off backlight when keyboard goes into idle state"

config ZMK_BACKLIGHT_AUTO_OFF_USB
    bool "Turn off backlight when USB is disconnected"

endif # ZMK_BACKLIGHT_MAP

config ZMK_BATTERY_INDICATOR
    bool "Enable RGB battery indicator"

config ZMK_BATTERY_INDICATOR_DURATION
    int "Battery indicator duration in seconds"
    default 5

config ZMK_BATTERY_INDICATOR_COLOR
    hex "Battery indicator color, when indicating, as hex 0xRRGGBB"
    default 0x00FF00

config ZMK_BATTERY_INDICATOR_LOW_THRESHOLD
    int "State of charge percent below which the indicator shows solid red"
    default 20

config ZMK_BATTERY_INDICATOR_HIGH_THRESHOLD
    int "State of charge percent at or above which the indicator shows a solid full bar"
    default 80

config ZMK_BATTERY_INDICATOR_CHARGING
    bool "Pulse the battery bar while USB power is connected"
    default y

config ZMK_CHARGE_STATE_REPORTING
    bool "Report USB charge state to the BLE host (BAS 1.1 Battery Level Status)"
    depends on ZMK_BLE && BT_BAS && USB_DEVICE_STACK
    depends on !ZMK_SPLIT || ZMK_SPLIT_ROLE_CENTRAL
    select BT_BAS_BLS
    help
      Drives Zephyr's Battery Level Status characteristic (0x2BED) from
      zmk_usb_is_powered(). Central half only: the peripheral cannot push VBUS
      state over the split link. Plain BAS (0x2A19) carries a level only, which
      is why this is needed at all.

config ZMK_SPLIT_BATTERY_TELEMETRY
    bool "Send split battery level and wired-power state over a dedicated input channel"
    default y if DT_HAS_ZMK_SPLIT_BATTERY_SOURCE_ENABLED
    depends on DT_HAS_ZMK_SPLIT_BATTERY_SOURCE_ENABLED
    depends on ZMK_SPLIT && ZMK_SPLIT_BLE && ZMK_BATTERY_REPORTING && SOC_NRF52840
    select ZMK_POINTING
    help
      Sends private MSC packets from a virtual input source through input-split
      reg 254. No input listener is attached, so telemetry cannot generate
      key or pointer reports. The central caches one peripheral with a timeout.
      Charging is inferred from raw USB VBUS, not charge current or Qi state;
      the board's VBUS wiring must be verified on hardware. Keymaps opt in by
      including telemetry/split_battery.dtsi. Reset builds disable BLE telemetry
      but can retain these nodes, so the inert virtual source device must still
      be compiled based on DT presence rather than this runtime option.

config ZMK_USB_BATTERY_REPORTING
    bool "Report keyboard battery levels and charge states over USB HID"
    depends on ZMK_USB && ZMK_BATTERY_REPORTING
    depends on !ZMK_SPLIT || ZMK_SPLIT_ROLE_CENTRAL
    help
      HID_1 reports the central battery; HID_2 reports the peripheral when split
      battery telemetry is enabled. Set USB_HID_DEVICE_COUNT=3 for both halves,
      or 2 for central-only reporting. Linux generic HID exposes device batteries;
      Linux 6.3+ also supports their Charging usage. Charging is inferred from
      each half's USB power, not charger current. Unknown/stale peer samples are
      withheld; generic host drivers can still cache an earlier reading. Feature
      report 2 includes explicit validity for raw readers. Central reporting does
      not require BLE or the BLE reporting option; the split relay requires BLE.

DT_COMPAT_ZMK_BOOT_MAGIC_KEY := zmk,boot-magic-key

config ZMK_BOOT_MAGIC_KEY
    bool "Enable actions when keys are held at boot"
    default $(dt_compat_enabled,$(DT_COMPAT_ZMK_BOOT_MAGIC_KEY))

config ZMK_BOOT_MAGIC_KEY_TIMEOUT_MS
    int "Milliseconds to wait for a boot magic key at startup"
    default 500

rsource "drivers/Kconfig"

endmenu
```

## boards/angry_miao/hatsu_left/Kconfig.defconfig
```kconfig
if BOARD_HATSU_LEFT

config ZMK_KEYBOARD_NAME
    default "Hatsu Left"

config ZMK_SPLIT_ROLE_CENTRAL
    default y

config BT_DEVICE_NAME
    default "Hatsu Left"

endif # BOARD_HATSU_LEFT
```

## boards/angry_miao/hatsu_left/Kconfig.hatsu_left
```kconfig
config BOARD_HATSU_LEFT
    select SOC_NRF52840_QIAA
    select ZMK_BOARD_COMPAT if BOARD_HATSU_LEFT_NRF52840_ZMK
    imply RETAINED_MEM if BOARD_HATSU_LEFT_NRF52840_ZMK
    imply RETENTION if BOARD_HATSU_LEFT_NRF52840_ZMK
    imply RETENTION_BOOT_MODE if BOARD_HATSU_LEFT_NRF52840_ZMK
```

## boards/angry_miao/hatsu_left/board.yml
```yaml
board:
  name: hatsu_left
  vendor: angry_miao
  socs:
    - name: nrf52840
      variants:
        - name: zmk
```

## boards/angry_miao/hatsu_right/Kconfig.defconfig
```kconfig
if BOARD_HATSU_RIGHT

config ZMK_KEYBOARD_NAME
    default "Hatsu Right"

config BT_DEVICE_NAME
    default "Hatsu Right"

endif # BOARD_HATSU_RIGHT
```

## boards/angry_miao/hatsu_right/Kconfig.hatsu_right
```kconfig
config BOARD_HATSU_RIGHT
    select SOC_NRF52840_QIAA
    select ZMK_BOARD_COMPAT if BOARD_HATSU_RIGHT_NRF52840_ZMK
    imply RETAINED_MEM if BOARD_HATSU_RIGHT_NRF52840_ZMK
    imply RETENTION if BOARD_HATSU_RIGHT_NRF52840_ZMK
    imply RETENTION_BOOT_MODE if BOARD_HATSU_RIGHT_NRF52840_ZMK
```

## boards/angry_miao/hatsu_right/board.yml
```yaml
board:
  name: hatsu_right
  vendor: angry_miao
  socs:
    - name: nrf52840
      variants:
        - name: zmk
```

## drivers/sensor/cw2015/Kconfig
```kconfig
DT_COMPAT_CELLWISE_CW2015 := cellwise,cw2015

menuconfig CW2015
    bool "CW2015 I2C-based Fuel Gauge"
    default $(dt_compat_enabled,$(DT_COMPAT_CELLWISE_CW2015))
    depends on I2C
    help
      Enable driver for CW2015 I2C-based Fuel Gauge. Supports measuring
      battery voltage and state-of-charge.

if CW2015

config SENSOR_CW2015_INIT_PRIORITY
    int "Init priority"
    default 75

endif # CW2015
```

## dts/bindings/behaviors/hatsu,behavior-bootloader.yaml
```yaml
description: |
  Reboots into the Adafruit UF2 bootloader by writing the DFU magic value
  directly to GPREGRET and resetting. Used because the Zephyr bootmode
  retention path does not work reliably on the Hatsu right half.

compatible: "hatsu,behavior-bootloader"

include: zero_param.yaml
```

## dts/bindings/behaviors/zmk,behavior-battery-indicator.yaml
```yaml
description: Battery Indicator Behavior

compatible: "zmk,behavior-battery-indicator"

include: zero_param.yaml
```

## dts/bindings/behaviors/zmk,behavior-layer-color.yaml
```yaml
description: Relays layer indicator colors across split halves

compatible: "zmk,behavior-layer-color"

include: zero_param.yaml
```

## dts/bindings/behaviors/zmk,behavior-split-battery-session.yaml
```yaml
description: Private split battery session challenge receiver

compatible: "zmk,behavior-split-battery-session"

include: two_param.yaml
```

## dts/bindings/sensor/cellwise,cw2015.yaml
```yaml
description: CW2015 Fuel Gauge

compatible: "cellwise,cw2015"

include: [i2c-device.yaml]
```

## dts/bindings/zmk,backlight-map.yaml
```yaml
description: Backlight LED channel map

compatible: "zmk,backlight-map"

properties:
  led-channels:
    type: phandle-array
    required: true
```

## dts/bindings/zmk,battery-indicator-map.yaml
```yaml
description: Battery indicator LED channel map

compatible: "zmk,battery-indicator-map"

properties:
  led-channels:
    type: phandle-array
    required: true
  colors:
    type: uint8-array
    required: true
```

## dts/bindings/zmk,layer-colors.yaml
```yaml
description: Per-layer RGB indicator colors

compatible: "zmk,layer-colors"

properties:
  colors:
    type: array
    required: true
```

## dts/bindings/zmk,split-battery-source.yaml
```yaml
# SPDX-License-Identifier: MIT

description: |
  Virtual input source for split battery telemetry. Emits only private MSC
  packets to a zmk,input-split proxy; do not attach a zmk,input-listener.

compatible: "zmk,split-battery-source"

include: [base.yaml]
```
